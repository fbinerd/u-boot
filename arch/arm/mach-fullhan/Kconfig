## arch/arm/mach-fullhan/Kconfig
```kconfig
if ARCH_FULLHAN

config SYS_SOC
	default "fullhan"

config TARGET_FULLHAN_IM7
	bool "Support Fullhan FH8626 Mibo iM7 / IPC-S21F"
	select CPU_V7A
	select DM
	select DM_SERIAL
	select OF_CONTROL
	help
	  Support for Fullhan FH8626 SoC on Intelbras Mibo iM7 / Dahua Imou IPC-S21F.

source "board/dahua/im7/Kconfig"

endif
```

## arch/mips/mach-rtl-otto/Kconfig
```kconfig
# SPDX-License-Identifier: GPL-2.0+

menu "Realtek OTTO platforms"
	depends on ARCH_RTL_OTTO

config SYS_SOC
	default "rtl-otto"

config SOC_RTL8380
	bool
	select MIPS_INIT_STACK_IN_SRAM
	select MIPS_TUNE_4KC
	select ROM_EXCEPTION_VECTORS
	select SUPPORT_BIG_ENDIAN
	# Stage-1 uses MIPS32 Release 2 instructions observed working on RTL8380.
	select SUPPORTS_CPU_MIPS32_R2
	help
	  Realtek RTL8380/RTL838x MIPS 4KEc switch SoCs.

config RTL838X_PORT_LED
	bool "RTL838x port LED engine, software control"
	depends on SOC_RTL8380
	help
	  Software control of the two LED channels of every port of the
	  RTL838x LED engine, without the driver-model LED stack.

config RTL8231_EXPANDER
	bool "Realtek RTL8231 GPIO expander on the RTL838x auxiliary MDIO bus"
	depends on SOC_RTL8380
	help
	  Minimal access to an RTL8231 behind the RTL838x auxiliary MDIO
	  controller (SoC GPIO2/GPIO3 as MDC/MDIO): start it and drive one
	  pin as an output.

choice
	prompt "Board select"

config TARGET_INTELBRAS_SG1002_MR
	bool "RTL8380M_INTPHY_2FIB_1G_DEMO"
	select SOC_RTL8380
	select RTL838X_PORT_LED
	select RTL8231_EXPANDER

endchoice

source "board/intelbras/sg1002_mr/Kconfig"

endmenu
```

## board/dahua/im7/Kconfig
```kconfig
if TARGET_FULLHAN_IM7

config SYS_BOARD
	default "im7"

config SYS_VENDOR
	default "dahua"

config SYS_CONFIG_NAME
	default "fullhan_im7"

config DEFAULT_DEVICE_TREE
	default "fullhan-fh8626-im7"

endif
```

## board/intelbras/sg1002_mr/Kconfig
```kconfig
# SPDX-License-Identifier: GPL-2.0+

if TARGET_INTELBRAS_SG1002_MR

config SYS_VENDOR
	default "intelbras"

config SYS_BOARD
	default "sg1002_mr"

config SYS_CONFIG_NAME
	default "intelbras_sg1002_mr"

config TEXT_BASE
	default 0x83f01000

config INTELBRAS_SG1002_MR_FACTORY_PAYLOAD
	bool "Factory bootstrap copied DDR payload"
	default y
	help
	  Reserve the initial 4 KiB of the factory-copied main payload for its
	  fixed entry trampoline while retaining a 64 KiB aligned MIPS text base.

endif
```

## configs/fullhan_im7_defconfig
```kconfig
CONFIG_ARM=y
CONFIG_ARCH_FULLHAN=y
CONFIG_TARGET_FULLHAN_IM7=y
CONFIG_TEXT_BASE=0xa0800000
CONFIG_SYS_LOAD_ADDR=0xa0008000
CONFIG_HAS_CUSTOM_SYS_INIT_SP_ADDR=y
CONFIG_CUSTOM_SYS_INIT_SP_ADDR=0xa083fff0
CONFIG_SYS_MALLOC_F_LEN=0x1000
CONFIG_SYS_MALLOC_LEN=0x100000
CONFIG_NR_DRAM_BANKS=1
CONFIG_ENV_SIZE=0x10000
CONFIG_ENV_IS_NOWHERE=y
CONFIG_CC_OPTIMIZE_FOR_SIZE=y
# CONFIG_EFI_LOADER is not set
# CONFIG_CMD_BOOTEFI is not set
# CONFIG_NET is not set
# CONFIG_CMD_NET is not set
CONFIG_DISPLAY_CPUINFO=y
CONFIG_DISPLAY_BOARDINFO=y
CONFIG_HUSH_PARSER=y
CONFIG_SYS_PROMPT="im7# "
CONFIG_CMD_BOOTM=y
CONFIG_CMD_MEMORY=y
CONFIG_CMD_RUN=y
CONFIG_CMD_MISC=y
CONFIG_DM=y
CONFIG_SERIAL_PRESENT=y
CONFIG_SYS_NS16550=y
CONFIG_SYS_NS16550_SERIAL=y
CONFIG_SYS_NS16550_MEM32=y
CONFIG_SYS_NS16550_REG_SHIFT=2
CONFIG_BAUDRATE=115200
CONFIG_OF_CONTROL=y
CONFIG_DEFAULT_DEVICE_TREE="fullhan-fh8626-im7"
```
