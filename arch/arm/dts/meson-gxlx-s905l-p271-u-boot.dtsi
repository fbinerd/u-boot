// SPDX-License-Identifier: (GPL-2.0+ OR MIT)
/*
 * U-Boot additions for the Amlogic Meson GXLX (S905L) P271 board.
 */

#include "meson-gxl-u-boot.dtsi"

&sd_emmc_c {
	/* This board's eMMC rejects CMD18/CMD25 multi-block transfers. */
	u-boot,max-block-count = <1>;
};
